## Kconfig.projbuild
```kconfig
# ESP32-C3 Bluetooth Headset Module Configuration

menu "Bluetooth Headset Configuration"
    
    config BT_HEADSET_DEVICE_NAME
        string "Bluetooth device name"
        default "ATH-R50x BT Module"
        help
            Name that will appear when scanning for Bluetooth devices
    
    config BT_HEADSET_PIN_CODE
        string "Bluetooth PIN code"
        default "0000"
        help
            PIN code for pairing (4 digits)
    
    config BT_HEADSET_AUTO_RECONNECT
        bool "Auto-reconnect to last device"
        default y
        help
            Automatically connect to the last paired device on startup
    
    menu "Audio Configuration"
        
        config AUDIO_SAMPLE_RATE
            int "Audio sample rate"
            default 44100
            help
                Sample rate in Hz (44100, 48000, etc.)
        
        config AUDIO_BITS_PER_SAMPLE
            int "Audio bits per sample"
            default 16
            help
                Bits per sample (16, 24, 32)
        
        config AUDIO_CHANNELS
            int "Audio channels"
            default 2
            help
                Number of audio channels (1=mono, 2=stereo)
        
        config AUDIO_BUFFER_SIZE
            int "Audio buffer size"
            default 1024
            help
                Size of audio buffer in samples
    
    endmenu
    
    menu "GPIO Configuration"
        
        config GPIO_I2S_BCK
            int "I2S BCK (bit clock) GPIO"
            default 4
            help
                GPIO pin for I2S bit clock
        
        config GPIO_I2S_WS
            int "I2S WS (word select) GPIO"
            default 5
            help
                GPIO pin for I2S word select
        
        config GPIO_I2S_DATA
            int "I2S DATA GPIO"
            default 6
            help
                GPIO pin for I2S data output
        
        config GPIO_BUTTON_PLAY
            int "Play/Pause button GPIO"
            default 0
            help
                GPIO pin for play/pause button
        
        config GPIO_BUTTON_VOL_UP
            int "Volume up button GPIO"
            default 1
            help
                GPIO pin for volume up button
        
        config GPIO_BUTTON_VOL_DOWN
            int "Volume down button GPIO"
            default 2
            help
                GPIO pin for volume down button
        
        config GPIO_LED_STATUS
            int "Status LED GPIO"
            default 8
            help
                GPIO pin for status LED
        
        config GPIO_BATTERY_ADC
            int "Battery ADC GPIO"
            default 3
            help
                GPIO pin for battery voltage monitoring
    
    endmenu
    
    menu "Power Management"
        
        config POWER_SLEEP_TIMEOUT
            int "Sleep timeout (seconds)"
            default 300
            help
                Time in seconds before entering deep sleep
        
        config POWER_LOW_BATTERY_THRESHOLD
            int "Low battery threshold (mV)"
            default 3400
            help
                Voltage threshold for low battery warning
        
        config POWER_SHUTDOWN_THRESHOLD
            int "Shutdown threshold (mV)"
            default 3200
            help
                Voltage threshold for automatic shutdown
        
        config POWER_BATTERY_CHECK_INTERVAL
            int "Battery check interval (seconds)"
            default 30
            help
                Interval for battery voltage monitoring
    
    endmenu

endmenu
```

## sdkconfig.defaults
```kconfig
# Default ESP-IDF build configuration
CONFIG_IDF_TARGET="esp32c3"
CONFIG_IDF_TARGET_ESP32C3=y

# Bluetooth configuration
CONFIG_BT_ENABLED=y
CONFIG_BT_CONTROLLER_ENABLED=y
CONFIG_BT_CONTROLLER_ONLY=n
CONFIG_BT_BLUEDROID_ENABLED=y
CONFIG_BT_CLASSIC_ENABLED=y
CONFIG_BT_A2DP_ENABLE=y
CONFIG_BT_AVRC_ENABLE=y
CONFIG_BT_HF_ENABLE=y
CONFIG_BT_SPP_ENABLE=y

# Audio configuration
CONFIG_ESP_A2DP_SINK_ENABLE=y
CONFIG_ESP_AVRC_CT_ENABLE=y

# Power management
CONFIG_PM_ENABLE=y
CONFIG_PM_DFS_INIT_AUTO=y
CONFIG_PM_USE_RTC_TIMER_REF=y

# Sleep configuration
CONFIG_ESP_SLEEP_POWER_DOWN_FLASH=y
CONFIG_ESP_SLEEP_RTC_BUS_ISO_WORKAROUND=y
CONFIG_ESP_SLEEP_GPIO_RESET_WORKAROUND=y

# I2S configuration
CONFIG_I2S_ENABLE=y

# ADC configuration
CONFIG_ADC_ENABLE=y
CONFIG_ADC_CAL_EFUSE_TP_ENABLE=y
CONFIG_ADC_CAL_EFUSE_VREF_ENABLE=y

# GPIO configuration
CONFIG_GPIO_ESP32_SUPPORT_SWITCH_SLP_PULL=y

# System configuration
CONFIG_ESP_SYSTEM_EVENT_QUEUE_SIZE=32
CONFIG_ESP_SYSTEM_EVENT_TASK_STACK_SIZE=2304
CONFIG_ESP_MAIN_TASK_STACK_SIZE=3584
CONFIG_ESP_MAIN_TASK_AFFINITY_CPU0=y

# FreeRTOS configuration
CONFIG_FREERTOS_USE_TRACE_FACILITY=y
CONFIG_FREERTOS_USE_STATS_FORMATTING_FUNCTIONS=y
CONFIG_FREERTOS_VTASKLIST_INCLUDE_COREID=y
CONFIG_FREERTOS_GENERATE_RUN_TIME_STATS=y

# Log configuration
CONFIG_LOG_DEFAULT_LEVEL_INFO=y
CONFIG_LOG_DEFAULT_LEVEL=3
CONFIG_LOG_MAXIMUM_LEVEL=5

# Application specific configuration
CONFIG_BT_HEADSET_DEVICE_NAME="ATH-R50x BT Module"
CONFIG_BT_HEADSET_PIN_CODE="0000"
CONFIG_BT_HEADSET_AUTO_RECONNECT=y
CONFIG_AUDIO_SAMPLE_RATE=44100
CONFIG_AUDIO_BITS_PER_SAMPLE=16
CONFIG_AUDIO_CHANNELS=2
CONFIG_AUDIO_BUFFER_SIZE=1024
CONFIG_GPIO_I2S_BCK=4
CONFIG_GPIO_I2S_WS=5
CONFIG_GPIO_I2S_DATA=6
CONFIG_GPIO_BUTTON_PLAY=0
CONFIG_GPIO_BUTTON_VOL_UP=1
CONFIG_GPIO_BUTTON_VOL_DOWN=2
CONFIG_GPIO_LED_STATUS=8
CONFIG_GPIO_BATTERY_ADC=3
CONFIG_POWER_SLEEP_TIMEOUT=300
CONFIG_POWER_LOW_BATTERY_THRESHOLD=3400
CONFIG_POWER_SHUTDOWN_THRESHOLD=3200
CONFIG_POWER_BATTERY_CHECK_INTERVAL=30
```
